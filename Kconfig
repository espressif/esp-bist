## samples/idf/sdkconfig.defaults
```kconfig
# Enable ULP
CONFIG_ULP_COPROC_ENABLED=y
CONFIG_ULP_COPROC_TYPE_LP_CORE=y
CONFIG_ULP_COPROC_RESERVE_MEM=16240
# Set log level to Warning to produce clean output
CONFIG_BOOTLOADER_LOG_LEVEL_WARN=y
CONFIG_BOOTLOADER_LOG_LEVEL=2
CONFIG_LOG_DEFAULT_LEVEL_WARN=y
CONFIG_LOG_DEFAULT_LEVEL=2
# BIST configuration
CONFIG_ESP_BIST=y
CONFIG_ESP_BIST_CPU_REG_TEST=y
CONFIG_ESP_BIST_CPU_CSR_REG_TEST=y
CONFIG_ESP_BIST_STACK_TEST=y
CONFIG_ESP_BIST_MEMORY_RAM_TEST=y
CONFIG_ESP_BIST_MEMORY_FLASH_TEST=y
CONFIG_ESP_BIST_WDT_TIMEOUT_US=50000
```

## samples/zephyr/testcase.yaml
```yaml
common:
  sysbuild: true
  integration_platforms:
    - esp32c5_devkitc/esp32c5/hpcore
    - esp32c6_devkitc/esp32c6/hpcore
tests:
  boards.espressif.bist_lp.selftest:
    tags:
      - bist
      - safety
    harness: ztest
    platform_allow:
      - esp32c5_devkitc/esp32c5/hpcore
      - esp32c6_devkitc/esp32c6/hpcore
```

## src/bist/Kconfig
```kconfig
mainmenu "Built In Self Test (BIST) Configuration"

config ESP_BIST
    bool "Enable Built In Self Test (BIST)"
    default y if !ZEPHYR_ESP_BIST_MODULE && !NUTTX_ESP_BIST_MODULE
    help
      Enable the built-in self-test (BIST) feature for the system.
      This feature allows for self-diagnosis and verification of system
      components during startup or at runtime.

menu "ESP-BIST Tests"
    depends on ESP_BIST

config ESP_BIST_CPU_REG_TEST
    bool "CPU Register Test"
    default y if !ZEPHYR_ESP_BIST_MODULE && !NUTTX_ESP_BIST_MODULE
    help
      Enable tests for CPU registers.

config ESP_BIST_CPU_CSR_REG_TEST
    bool "CPU CSR Register Test"
    default y if !ZEPHYR_ESP_BIST_MODULE && !NUTTX_ESP_BIST_MODULE
    help
      Enable tests for CPU Control and Status Registers (CSRs).

config ESP_BIST_MEMORY_RAM_TEST
    bool "Memory RAM Test"
    default y if !ZEPHYR_ESP_BIST_MODULE && !NUTTX_ESP_BIST_MODULE
    help
        Enable tests for the RAM memory integrity (March A, March X, and
        Abraham).

config ESP_BIST_RAM_PARTITION_SIZE
    int "RAM test partition size (words)"
    depends on ESP_BIST_MEMORY_RAM_TEST
    default 256 if IDF_ESP_BIST_COMPONENT || ZEPHYR_ESP_BIST_MODULE || NUTTX_ESP_BIST_MODULE
    default 512
    help
        Size of each RAM test partition in 32-bit words. March A/X test one
        partition at a time; Abraham tests pairs. Larger values reduce the
        number of Abraham pairs C(N,2) and thus the execution time of
        bist_ram_test_abraham_full(), at the cost of a larger safe-RAM
        backup buffer (2 x partition_size x 4 bytes).

        Common values:
          256  = 1 KiB partitions, 2 KiB backup buffer (LP core default)
          512  = 2 KiB partitions, 4 KiB backup buffer (standalone default)
          1024 = 4 KiB partitions, 8 KiB backup buffer

config ESP_BIST_STACK_TEST
    bool "Stack Test"
    default y if !ZEPHYR_ESP_BIST_MODULE && !NUTTX_ESP_BIST_MODULE
    help
      Enable tests for the stack integrity.

config ESP_BIST_PROGRAM_COUNTER_TEST
    bool "Program Counter Test"
    depends on !IDF_ESP_BIST_COMPONENT && !ZEPHYR_ESP_BIST_MODULE && !NUTTX_ESP_BIST_MODULE
    default y
    help
      Enable tests for the program counter.

config ESP_BIST_MEMORY_FLASH_TEST
    bool "Memory Flash Test"
    default y if !ZEPHYR_ESP_BIST_MODULE && !NUTTX_ESP_BIST_MODULE
    help
      Enable tests for the Flash memory integrity.

config ESP_BIST_CLOCK_TEST
    bool "Clock Test"
    depends on !IDF_ESP_BIST_COMPONENT && !ZEPHYR_ESP_BIST_MODULE && !NUTTX_ESP_BIST_MODULE
    default y
    help
      Enable tests for the main crystal clock.

config ESP_BIST_GPIO_TEST
    bool "GPIO Test"
    depends on !IDF_ESP_BIST_COMPONENT && !ZEPHYR_ESP_BIST_MODULE && !NUTTX_ESP_BIST_MODULE
    default y
    help
      Enable tests for the GPIO pins.

config ESP_BIST_ADC_TEST
    bool "ADC Test"
    depends on !IDF_ESP_BIST_COMPONENT && !ZEPHYR_ESP_BIST_MODULE && !NUTTX_ESP_BIST_MODULE
    default y
    help
      Enable tests for the ADC pins.

config ESP_BIST_WATCHDOG_TEST
    bool "Watchdog Test"
    depends on !IDF_ESP_BIST_COMPONENT && !ZEPHYR_ESP_BIST_MODULE && !NUTTX_ESP_BIST_MODULE
    default y
    help
      Enable tests for the HP main watchdog timer (MWDT).

config ESP_BIST_INTERRUPT_TEST
    bool "Interrupt Test"
    depends on !IDF_ESP_BIST_COMPONENT && !ZEPHYR_ESP_BIST_MODULE && !NUTTX_ESP_BIST_MODULE
    default y
    help
      Enable tests for software and hardware interrupts.

endmenu

config ESP_BIST_WDT_TIMEOUT_US
    int "WDT Timeout (us)"
    depends on ESP_BIST
    default 50000
    help
      Maximum time between watchdog feeds in microseconds.

      On the LP core (ESP-IDF ULP integration), this configures the LP WDT
      timeout via lp_wdt_init(). On HP core / standalone builds, this configures
      the main watchdog timer (MWDT).

config ESP_BIST_LP_DEBUG_LOG
    bool "Enable LP-core debug logging (ESP_LOGD)"
    depends on ESP_BIST && (IDF_ESP_BIST_COMPONENT || ZEPHYR_ESP_BIST_MODULE)
    help
      Compile in ESP_LOGD output on the LP core. Disabled by default to keep
      LP firmware small (~16 KiB SRAM).

config BIST_FLASH_TEST_CHUNK_SIZE
    hex "Flash Test Chunk Size"
    depends on ESP_BIST && ESP_BIST_MEMORY_FLASH_TEST
    default 0x1000
    help
      Specify the chunk size in bytes for flash memory testing.

config ESP_BIST_CLOCK_PERCENT_FREQUENCY_DRIFT
    int "Clock Frequency Drift Percentage"
    depends on ESP_BIST && ESP_BIST_CLOCK_TEST
    range 0 100
    default 1
    help
      Specify the acceptable percentage of frequency drift for the clock test.

config ESP_BIST_ADC_PERCENT_DEVIATION
    int "ADC Reading Deviation Percentage"
    depends on ESP_BIST_ADC_TEST
    range 0 100
    default 6
    help
      Specify the acceptable percentage deviation of ADC readings from
      the expected low or high reference values for the ADC plausibility tests.

config ESP_BIST_FLASH_SIZE
    hex "Flash Size"
    depends on ESP_BIST && !IDF_ESP_BIST_COMPONENT && !ZEPHYR_ESP_BIST_MODULE && !NUTTX_ESP_BIST_MODULE
    default 0x400000
    help
      Specify the size of the flash memory in bytes.

config ESP_BIST_HEAP_SIZE
    hex "Heap Size"
    depends on ESP_BIST && !IDF_ESP_BIST_COMPONENT && !ZEPHYR_ESP_BIST_MODULE && !NUTTX_ESP_BIST_MODULE
    default 0x1000
    help
      Specify the size of the heap in bytes. This is used for dynamic memory allocation
      during BIST operations. A value of 0 means no heap is allocated.

config ESP_BIST_STACK_PROTECTION_BLOCK_SIZE
    hex "Stack Protection Block Size"
    depends on ESP_BIST && !IDF_ESP_BIST_COMPONENT && !ZEPHYR_ESP_BIST_MODULE && !NUTTX_ESP_BIST_MODULE
    default 0x100
    help
      Specify the size of the stack protection block in bytes. This is used to protect
      the stack from overflow and underflow conditions. A value of 0 means no protection
      block is allocated.

config ESP_BIST_WDT_WINDOWED_UNDERFLOW_TIMEOUT_US
    int "WDT Windowed Underflow Timeout (us)"
    depends on ESP_BIST && !IDF_ESP_BIST_COMPONENT && !ZEPHYR_ESP_BIST_MODULE && !NUTTX_ESP_BIST_MODULE
    default 10
    help
      Specify the timeout for the windowed underflow condition in microseconds.
      This is used to ensure that the watchdog timer does not trigger an underflow
      condition during application time-slot.

config ESP_BIST_METRICS
    bool "BIST Metrics Collection"
    depends on ESP_BIST && !IDF_ESP_BIST_COMPONENT && !ZEPHYR_ESP_BIST_MODULE && !NUTTX_ESP_BIST_MODULE
    default y
    help
      Enable the collection of performance metrics during BIST operations, such as
      execution time, CPU cycles, and instruction counts.

menu "Host Diagnostics"
    depends on IDF_ESP_BIST_COMPONENT || ZEPHYR_ESP_BIST_MODULE || NUTTX_ESP_BIST_MODULE

config ESP_BIST_HOST_DIAGNOSTICS
    bool "Enable Host Diagnostics"
    help
      Enable companion supervision of a QM host OS via the Host Diagnostics
      agent. The LP companion schedules host audits and
      owns safe-state decisions; the host only collaborates.

menu "Host Diagnostics Audits"
    depends on ESP_BIST_HOST_DIAGNOSTICS

config ESP_BIST_HD_AUDIT_QA
    bool "Q&A challenge / window"
    default y
    help
      Companion issues a challenge; host must answer f(challenge, seq) inside
      the configured window.

config ESP_BIST_HD_AUDIT_CHECKPOINT
    bool "Alive / deadline / logical checkpoints"
    help
      Host reports checkpoints; companion tracks set, order, and deadlines.

config ESP_BIST_HD_AUDIT_RAM
    bool "Host RAM March"
    select ESP_BIST_MEMORY_RAM_TEST
    help
      Host runs March tests on an HP DRAM region under companion trigger.
      Requires HP linker symbols for the test region and safe stack (later).

config ESP_BIST_HD_AUDIT_FLASH
    bool "Host flash / image CRC"
    select ESP_BIST_MEMORY_FLASH_TEST
    help
      Host computes CRC of HP .flash.text on DIAG_REQ; companion compares
      against a build-injected golden. Host PASS alone is never trusted.
      Not wired yet (challenge-only Host Diagnostics).

config ESP_BIST_HD_AUDIT_CPU
    bool "Host CPU register test"
    select ESP_BIST_CPU_REG_TEST
    help
      Host runs CPU general-purpose register tests under companion trigger.

config ESP_BIST_HD_AUDIT_CSR
    bool "Host CSR / PMP-PMA config audit"
    select ESP_BIST_CPU_CSR_REG_TEST
    help
      Host runs CSR (and related config) diagnostics under companion trigger.

config ESP_BIST_HD_AUDIT_STACK
    bool "Stack overflow / canary / watermark"
    select ESP_BIST_STACK_TEST
    help
      Host stack integrity check, companion-demandable.

config ESP_BIST_HD_AUDIT_CLOCK
    bool "Clock / crystal drift"
    help
      Clock monitoring for the host time base (FTTI integrity). May use
      companion independent time-slot and/or host measurement.

config ESP_BIST_HD_AUDIT_WDT
    bool "Host WDT path check"
    help
      Host reports armed/feed counters; companion checks the pattern.

config ESP_BIST_HD_AUDIT_PC
    bool "PC / program-flow sample"
    help
      Host program-counter / program-flow sample under companion trigger.

config ESP_BIST_HD_AUDIT_IRQ_LATENCY
    bool "Interrupt latency / storm bound"
    help
      Companion measures challenge-to-answer latency against a budget.

config ESP_BIST_HD_AUDIT_GPIO
    bool "Peripheral / GPIO plausibility"
    help
      Critical GPIO plausibility via companion read or host report.
      If enabled without an app callback where required, fails NOT_CONFIGURED.

config ESP_BIST_HD_AUDIT_ADC
    bool "ADC / supply plausibility"
    help
      Analog / supply plausibility via host or companion ADC when available.
      If enabled without an app callback where required, fails NOT_CONFIGURED.

config ESP_BIST_HD_AUDIT_CONFIG_NVM
    bool "Config / NVM / partition integrity"
    help
      Host CRC over configured regions; golden from build or provisioning.

config ESP_BIST_HD_AUDIT_IPC
    bool "IPC / shared-mem integrity"
    help
      Protocol sequence/CRC enforcement and optional explicit IPC self-check.

config ESP_BIST_HD_AUDIT_SECURE_BOOT
    bool "Secure-boot / image authenticity status"
    help
      Host reports secure-boot state; companion may gate supervision on it.

config ESP_BIST_HD_AUDIT_DUAL_CHANNEL
    bool "Dual-channel output compare"
    help
      App-registered compare/cut-off callbacks; library invokes only.

endmenu # Host Diagnostics Audits

config ESP_BIST_HD_CHALLENGE_WINDOW_US
    int "Challenge response window (us)"
    depends on ESP_BIST_HOST_DIAGNOSTICS
    default 10000
    range 100 10000000
    help
      Maximum time allowed for the host to answer a Q&A challenge.
      Sized from the product FTTI budget.

config ESP_BIST_HD_DIAG_TIMEOUT_US
    int "Diagnostic response timeout (us)"
    depends on ESP_BIST_HOST_DIAGNOSTICS
    default 50000
    range 100 60000000
    help
      Maximum time allowed for the host to complete a companion-triggered
      diagnostic (DIAG_REQ → DIAG_RSP).

config ESP_BIST_HD_AGENT_READY_TIMEOUT_US
    int "Agent ready timeout (us)"
    depends on ESP_BIST_HOST_DIAGNOSTICS
    default 1000000
    range 1000 60000000
    help
      Maximum time the companion waits for AGENT_READY after its own BIST before
      entering safe state.

config ESP_BIST_HD_AGENT_TASK_STACK
    int "Host Diagnostic Agent stack size (bytes)"
    depends on ESP_BIST_HOST_DIAGNOSTICS
    default 3072
    range 1024 16384
    help
      Stack for the high-priority HP thread/task that answers companion
      audits. Sized for the deepest enabled audit handler.

config ESP_BIST_HD_AGENT_TASK_PRIO
    int "Host Diagnostic Agent task priority"
    depends on ESP_BIST_HOST_DIAGNOSTICS && IDF_ESP_BIST_COMPONENT
    default 24
    range 1 24
    help
      FreeRTOS priority for the HP agent task. Must outrank application
      threads that could otherwise miss the challenge window.

config ESP_BIST_HD_AGENT_THREAD_COOP_PRIO
    int "Host Diagnostic Agent cooperative priority"
    depends on ESP_BIST_HOST_DIAGNOSTICS && ZEPHYR_ESP_BIST_MODULE
    default 0
    range 0 15
    help
      Cooperative priority index for the HP agent thread, passed to
      K_PRIO_COOP(). Lower values rank higher, and the agent must outrank
      application threads that could otherwise miss the challenge window.
      Must be below CONFIG_NUM_COOP_PRIORITIES.

config ESP_BIST_HD_AGENT_TASK_PRIO_NUTTX
    int "Host Diagnostic Agent task priority (NuttX)"
    depends on ESP_BIST_HOST_DIAGNOSTICS && NUTTX_ESP_BIST_MODULE
    default 254
    range 1 255
    help
      NuttX SCHED_FIFO priority for the HP agent pthread. Must outrank
      application threads that could otherwise miss the challenge window.

config ESP_BIST_HD_CHALLENGE_KEY
    hex "Challenge response key"
    depends on ESP_BIST_HOST_DIAGNOSTICS
    default 0xA5A5A5A5
    help
      Secret key mixed into bist_hd_challenge_answer(challenge, seq).
      Default is for development only; override per product.

endmenu # Host Diagnostics
```

## tests/integration/hd_idf/main/Kconfig.projbuild
```kconfig
# Copyright (c) 2026 Espressif Systems (Shanghai) Co., Ltd.
# SPDX-License-Identifier: Apache-2.0

menu "Host Diagnostics fail-closed validation"

comment "Select one fault. The ESP-BIST library is unchanged; the fault comes from this app."

config BIST_HD_TEST_KEY_MISMATCH
    bool "Build the host agent with a challenge key the companion does not share"
    default n
    help
      Compiles the HP-side library with BIST_HD_CHALLENGE_KEY set to a value
      other than CONFIG_ESP_BIST_HD_CHALLENGE_KEY, which the LP companion keeps.
      The production answer path then produces a wrong answer every round, so
      the companion must enter safe state.

config BIST_HD_TEST_STARVE_AGENT
    bool "Starve the Host Diagnostic Agent past the challenge window"
    default n
    help
      app_main() raises its own priority above the agent task and busy-waits,
      occupying every HP core, so no ANSWER reaches the companion before the
      challenge window expires.

endmenu
```
